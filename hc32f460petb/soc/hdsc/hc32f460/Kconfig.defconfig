## hc32f460petb/soc/hdsc/hc32f460/Kconfig.defconfig
```kconfig
# SPDX-License-Identifier: Apache-2.0

if SOC_HC32F460

config NUM_IRQS
	default 144

config SYS_CLOCK_HW_CYCLES_PER_SEC
	default 8000000

endif # SOC_HC32F460
```
