## f411ceu6/boards/weact/f411ceu6/Kconfig.defconfig
```kconfig
# Copyright (c) 2026
# SPDX-License-Identifier: Apache-2.0

# F411CEU6 local board configuration

if BOARD_F411CEU6

config SPI_STM32_INTERRUPT
	default y
	depends on SPI

endif # BOARD_F411CEU6
```

## f411ceu6/boards/weact/f411ceu6/Kconfig.f411ceu6
```kconfig
# Copyright (c) 2026
# SPDX-License-Identifier: Apache-2.0

config BOARD_F411CEU6
	select SOC_STM32F411XE
```

## f411ceu6/boards/weact/f411ceu6/board.yml
```yaml
board:
  name: f411ceu6
  full_name: WeAct STM32F411CEU6 (CMSIS-DAP)
  vendor: weact
  socs:
    - name: stm32f411xe
```

## hc32/boards/hdsc/hc32f460petb/Kconfig.hc32f460petb
```kconfig
# SPDX-License-Identifier: Apache-2.0

config BOARD_HC32F460PETB
	select SOC_HC32F460
```

## hc32/boards/hdsc/hc32f460petb/board.yml
```yaml
board:
  name: hc32f460petb
  full_name: HC32F460PETB Custom Board
  vendor: hdsc
  socs:
    - name: hc32f460
```

## hc32/boards/hdsc/hc32f460petb/hc32f460petb_defconfig
```kconfig
# SPDX-License-Identifier: Apache-2.0

# Enable GPIO
CONFIG_CLOCK_CONTROL=y
CONFIG_GPIO=y
CONFIG_PINCTRL=y

# Enable serial / UART console
CONFIG_SERIAL=y
CONFIG_CONSOLE=y
CONFIG_UART_CONSOLE=y

# Enable MPU
CONFIG_ARM_MPU=y
CONFIG_HW_STACK_PROTECTION=y
```

## hc32/boards/hdsc/hc32f4a0pgtb/Kconfig.hc32f4a0pgtb
```kconfig
# SPDX-License-Identifier: Apache-2.0

config BOARD_HC32F4A0PGTB
	select SOC_HC32F4A0
```

## hc32/boards/hdsc/hc32f4a0pgtb/board.yml
```yaml
board:
  name: hc32f4a0pgtb
  full_name: HC32F4A0PGTB FMR_CC Control Board
  vendor: hdsc
  socs:
    - name: hc32f4a0
```

## hc32/boards/hdsc/hc32f4a0pgtb/hc32f4a0pgtb_defconfig
```kconfig
# SPDX-License-Identifier: Apache-2.0

# Clocks and GPIO
CONFIG_CLOCK_CONTROL=y
CONFIG_GPIO=y
CONFIG_PINCTRL=y

# Serial / console
CONFIG_SERIAL=y
CONFIG_CONSOLE=y
CONFIG_UART_CONSOLE=y

# MPU off for the initial bring-up (FMR_CC main.c uses extensive
# peripheral register access; enable later once drivers stabilise)
CONFIG_ARM_MPU=n
CONFIG_HW_STACK_PROTECTION=n
```

## hc32/drivers/Kconfig
```kconfig
# SPDX-License-Identifier: Apache-2.0

rsource "clock_control/Kconfig"
rsource "counter/Kconfig"
rsource "gpio/Kconfig"
rsource "pinctrl/Kconfig"
rsource "serial/Kconfig"
rsource "watchdog/Kconfig"
rsource "watchdog/Kconfig"
```

## hc32/drivers/clock_control/Kconfig
```kconfig
# SPDX-License-Identifier: Apache-2.0

config CLOCK_CONTROL_HC32
	bool "HC32F460 clock controller"
	default y
	depends on DT_HAS_HDSC_HC32_CLOCK_ENABLED
	select CLOCK_CONTROL
	help
	  Enable the HC32F460 clock controller. This driver programs the
	  board's HXT 8 MHz -> PLL 200 MHz default clock tree and exposes
	  FCG peripheral gate control plus runtime bus-rate queries.
```

## hc32/drivers/counter/Kconfig
```kconfig
# SPDX-License-Identifier: Apache-2.0

config COUNTER_HC32_TMRA
	bool "HC32F460 TMRA counter"
	default y
	depends on DT_HAS_HDSC_HC32_TMRA_COUNTER_ENABLED
	select COUNTER
	select DYNAMIC_INTERRUPTS
	help
	  Enable the HC32F460 TMRA-based Zephyr counter driver.
	  The first implementation targets TMRA1 in software-clock,
	  sawtooth count-up mode with runtime top-value and alarm support.
```

## hc32/drivers/gpio/Kconfig
```kconfig
# SPDX-License-Identifier: Apache-2.0

config GPIO_HC32
	bool "HC32 GPIO driver"
	default y
	depends on DT_HAS_HDSC_HC32_GPIO_ENABLED
	select DYNAMIC_INTERRUPTS
	help
	  GPIO driver for HC32F460 / HC32F4A0 SoC. Supports EXTINT external
	  interrupts via INTC SEL routing; DYNAMIC_INTERRUPTS is required for
	  runtime NVIC IRQ allocation.
```

## hc32/drivers/pinctrl/Kconfig
```kconfig
# SPDX-License-Identifier: Apache-2.0

config PINCTRL_HC32
	bool "HC32F460 pin control"
	default y
	depends on DT_HAS_HDSC_HC32_PINCTRL_ENABLED
	select PINCTRL
	help
	  Enable the HC32F460 pinctrl implementation used by peripheral
	  drivers to program PFSR/PCR state from devicetree pinctrl states.
```

## hc32/drivers/watchdog/Kconfig
```kconfig
# SPDX-License-Identifier: Apache-2.0

config WDT_HC32_WDT
	bool "HC32F460 WDT window watchdog"
	default y
	depends on DT_HAS_HDSC_HC32_WDT_ENABLED
	select WATCHDOG
	help
	  Enable the HC32F460 runtime-configurable WDT driver. This maps the
	  PCLK3-based WDT block to Zephyr's watchdog API and supports contiguous
	  refresh windows, reset mode, and interrupt mode with a callback.

config WDT_HC32_SWDT
	bool "HC32F460 SWDT independent watchdog"
	default y
	depends on DT_HAS_HDSC_HC32_SWDT_ENABLED
	select WATCHDOG
	help
	  Enable the HC32F460 SWDT driver. The SWDT timeout is fixed by the ICG
	  preload words at flash offset 0x400 and starts on the first feed.
```

## hc32/dts/bindings/watchdog/hdsc,hc32-wdt.yaml
```yaml
# SPDX-License-Identifier: Apache-2.0

description: HC32F460 runtime-configurable window watchdog

compatible: "hdsc,hc32-wdt"

include: base.yaml

properties:
  reg:
    required: true

  clocks:
    required: true

  interrupts:
    required: true

  int-src:
    type: int
    required: true
    description: HC32 INTC peripheral interrupt source number.
```

## hc32/soc/hdsc/hc32f460/Kconfig.defconfig
```kconfig
# SPDX-License-Identifier: Apache-2.0

if SOC_HC32F460

config NUM_IRQS
	default 144

config SYS_CLOCK_HW_CYCLES_PER_SEC
	default 200000000

configdefault SYSTEM_CLOCK_HW_CYCLES_PER_SEC_RUNTIME_UPDATE
	default y if CORTEX_M_SYSTICK

endif # SOC_HC32F460
```

## hc32/soc/hdsc/hc32f460/Kconfig.soc
```kconfig
# SPDX-License-Identifier: Apache-2.0
# HC32F460 SoC family

config SOC_FAMILY_HC32
	bool

config SOC_FAMILY
	default "hc32" if SOC_FAMILY_HC32

config SOC_HC32F460
	bool
	select SOC_FAMILY_HC32
	select ARM
	select CPU_CORTEX_M4
	select CPU_CORTEX_M_HAS_DWT
	select CPU_HAS_FPU
	select CPU_HAS_ARM_MPU
	select HAS_PM
	select SOC_EARLY_INIT_HOOK
	select HAS_SWO

config SOC_SERIES
	default "hc32f460" if SOC_HC32F460

config SOC
	default "hc32f460" if SOC_HC32F460
```

## hc32/soc/hdsc/hc32f4a0/Kconfig
```kconfig
# SPDX-License-Identifier: Apache-2.0

config SOC_FAMILY_HC32
	select BUILD_OUTPUT_HEX

# Source out-of-tree driver Kconfig files (only the active SoC's Kconfig is
# sourced by Zephyr, so this is not a duplicate of the F460 Kconfig).
rsource "../../../drivers/Kconfig"
```

## hc32/soc/hdsc/hc32f4a0/Kconfig.defconfig
```kconfig
# SPDX-License-Identifier: Apache-2.0

if SOC_HC32F4A0

config NUM_IRQS
	default 144

config SYS_CLOCK_HW_CYCLES_PER_SEC
	default 240000000

config SYSTEM_CLOCK_HW_CYCLES_PER_SEC_RUNTIME_UPDATE
	default y if CORTEX_M_SYSTICK

endif # SOC_HC32F4A0
```

## hc32/soc/hdsc/hc32f4a0/Kconfig.soc
```kconfig
# SPDX-License-Identifier: Apache-2.0
# HC32F4A0 SoC family

config SOC_FAMILY_HC32
	bool

config SOC_FAMILY
	default "hc32" if SOC_FAMILY_HC32

config SOC_HC32F4A0
	bool
	select SOC_FAMILY_HC32
	select ARM
	select CPU_CORTEX_M4
	select CPU_CORTEX_M_HAS_DWT
	select CPU_HAS_FPU
	select CPU_HAS_ARM_MPU
	select HAS_PM
	select SOC_EARLY_INIT_HOOK
	select HAS_SWO

config SOC_SERIES
	default "hc32f4a0" if SOC_HC32F4A0

config SOC
	default "hc32f4a0" if SOC_HC32F4A0
```

## hc32f460petb/drivers/Kconfig
```kconfig
# SPDX-License-Identifier: Apache-2.0

rsource "gpio/Kconfig"
rsource "serial/Kconfig"
```

## hc32f460petb/drivers/gpio/Kconfig
```kconfig
# SPDX-License-Identifier: Apache-2.0

config GPIO_HC32
	bool "HC32F460 GPIO driver"
	default y
	depends on DT_HAS_HDSC_HC32_GPIO_ENABLED
	help
	  GPIO driver for HC32F460 SoC.
```

## hc32f460petb/drivers/serial/Kconfig
```kconfig
# SPDX-License-Identifier: Apache-2.0

config UART_HC32
	bool "HC32F460 USART driver"
	default y
	depends on DT_HAS_HDSC_HC32_USART_ENABLED
	select SERIAL_HAS_DRIVER
	help
	  UART driver for HC32F460 USART peripheral.
	  Supports polling mode by default. Enable UART_HC32_INTERRUPT
	  for interrupt-driven operation (required by shell).

config UART_HC32_INTERRUPT
	bool "HC32F460 USART interrupt support"
	depends on UART_HC32
	select SERIAL_SUPPORT_INTERRUPT
	select UART_INTERRUPT_DRIVEN
	select DYNAMIC_INTERRUPTS
	help
	  Enable interrupt-driven UART for HC32F460.
	  Uses INTC SEL registers to map USART interrupt sources
	  (RX full, RX error, TX empty, TX complete) to NVIC IRQs.

config UART_HC32_DMA
	bool "HC32F460 USART DMA support"
	depends on UART_HC32
	depends on !UART_HC32_INTERRUPT
	select SERIAL_SUPPORT_ASYNC
	select UART_ASYNC_API
	select DYNAMIC_INTERRUPTS
	help
	  Enable DMA-based async UART for HC32F460 USART.
	  Uses DMA1 for RX and DMA2 for TX, triggered by USART
	  events via AOS.  Mutually exclusive with interrupt mode.
```

## hc32f460petb/soc/hdsc/hc32f460/Kconfig
```kconfig
# SPDX-License-Identifier: Apache-2.0

config SOC_FAMILY_HC32
	select BUILD_OUTPUT_HEX

# Source out-of-tree driver Kconfig files
rsource "../../../drivers/Kconfig"
```
